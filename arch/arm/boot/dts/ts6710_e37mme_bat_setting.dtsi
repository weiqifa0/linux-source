/*
 * Copyright (C) 2016 MediaTek Inc.
 *
 * This program is free software; you can redistribute it and/or modify
 * it under the terms of the GNU General Public License version 2 as
 * published by the Free Software Foundation.
 *
 * This program is distributed in the hope that it will be useful,
 * but WITHOUT ANY WARRANTY; without even the implied warranty of
 * MERCHANTABILITY or FITNESS FOR A PARTICULAR PURPOSE.
 * See http://www.gnu.org/licenses/gpl-2.0.html for more details.
 */

/*************************
 * Customized Battery Setting dtsi file
*************************/
&bat_comm {
	/* cust_charging.h */
	/* stop charging while in talking mode */
	stop_charging_in_takling = <1>;
	talking_recharge_voltage = <3800>;
	talking_sync_time = <60>;

	/* Battery Temperature Protection */
	mtk_temperature_recharge_support = <1>;
	max_charge_temperature = <55>;
	max_charge_temperature_minus_x_degree = <50>;
	min_charge_temperature = <0>;
	min_charge_temperature_plus_x_degree = <1>;
	err_charge_temperature = <100>;

	/* Linear Charging Threshold */
	v_pre2cc_thres = <3400>;	/* unit: mV */
	v_cc2topoff_thres = <4250>;
	charging_full_current = <200>; /* unit: mA */

	/* Charging Current Setting */
	config_usb_if = <0>;
	usb_charger_current_suspend = <0>;	/* Unit: 0.01 mA */
	usb_charger_current_configured = <50000>;	/* Unit: 0.01 mA */
	usb_charger_current_unconfigured = <50000 >;	/* Unit: 0.01 mA */
	ac_charger_current = <105000 >;	/* Unit: 0.01 mA    550  650  850 1050 1150 1350 1450*/
	non_std_ac_charger_current = <105000 >;	/* Unit: 0.01 mA */
	charging_host_charger_current = <65000>;	/* Unit: 0.01 mA */
	apple_0_5a_charger_current = <50000>;	/* Unit: 0.01 mA */
	apple_1_0a_charger_current = <65000>;	/* Unit: 0.01 mA */
	apple_2_1a_charger_current = <80000>;	/* Unit: 0.01 mA */

	/* charger error check */
	bat_low_temp_protect_enable = <1>;
	v_charger_enable = <0>;	/* 1:on , 0:off */
	v_charger_max = <6000>;	/* unit: mV */
	v_charger_min = <4400>;

	/*  Tracking TIME */
	onehundred_percent_tracking_time = <10>;	/* Unit: second */
	npercent_tracking_time = <20>;	/* Unit: second */
	sync_to_real_tracking_time = <60>;	/* Unit: second */
	v_0percent_tracking = <3350 >;	/* Unit: mV */
    recharging_voltage = <4300>;
	/* High battery support */
	high_battery_voltage_support = <1>;
};

&bat_meter {
	/* cust_battery_meter.h */
	/* ADC resistor  */
	r_bat_sense = <4>;
	r_i_sense = <4>;
	r_charger_1 = <330>;
	r_charger_2 = <39>;
	temperature_t0 = <110>;
	temperature_t1 = <0>;
	temperature_t2 = <25>;
	temperature_t3 = <50>;
	temperature_t = <255>;	/* this should be fixed, never change the value */
	fg_meter_resistance = <0>;

	/* Qmax for 0mA */
	q_max_pos_50 = <2658 >;
	q_max_pos_25 = <2674 >;
	q_max_pos_0 = <2675 >;
	q_max_neg_10 = <2668 >;
	
/* Qmax for BYD 0mA */
	q_max_pos_byd_50 = <2600 >;
	q_max_pos_byd_25 = <2600 >;
	q_max_pos_byd_0 = <1550 >;
	q_max_neg_byd_10 = <1000 >;
	/* Qmax for BYD 400mA, said high current */
	q_max_pos_byd_50_h_current = <2600 >;
	q_max_pos_byd_25_h_current = <2600 >;
	q_max_pos_byd_0_h_current = <1550>;
	q_max_neg_byd_10_h_current = <1058>;
	
	/* Qmax for 400mA, said high current */
	q_max_pos_50_h_current = <2628 >;
	q_max_pos_25_h_current = <2656 >;
	q_max_pos_0_h_current = <2263 >;
	q_max_neg_10_h_current = <907 >;
	/* Discharge percentage, 1: D5, 0: D2 */
	oam_d5 = <1 >;

	change_tracking_point = <1>;
	/* SW OCV tracking setting */
	cust_tracking_point = <1 >;
	cust_r_sense = <56>;
	cust_hw_cc = <0>;
	aging_tuning_value = <103 >;
	cust_r_fg_offset = <0>;
	ocv_board_compesate = <0>;
	r_fg_board_base = <1000>;
	r_fg_board_slope = <1000>;
	car_tune_value = <100 >;

	/* HW Fuel gague  */
	current_detect_r_fg = <10>;	/* Unit: mA */
	minerroroffset = <1000>;
	fg_vbat_average_size = <18>;
	r_fg_value = <10>;	/* Unit: mOhm */

	cust_poweron_delta_capacity_tolrance = <65>;
	cust_poweron_low_capacity_tolrance = <5 >;
	cust_poweron_max_vbat_tolrance = <90 >;
	cust_poweron_delta_vbat_tolrance = <30 >;
	cust_poweron_delta_hw_sw_ocv_capacity_tolrance = <10>;

	/* Fixed battery temperature */
	fixed_tbat_25 = <1>;
	/* Dynamic change wake up period of battery thread when suspend */
	vbat_normal_wakeup = <3600>;	/* Unit: mV */
	vbat_low_power_wakeup = <3500>;	/* Unit: mV */
	normal_wakeup_period = <5400>;	/* Unit: second */
	low_power_wakeup_period = <300>;	/* Unit: second */
	close_poweroff_wakeup_period = <30>;	/* Unit: second */

	rbat_pull_up_r = <16900>;
	rbat_pull_up_d = <27000 >;
	rbat_pull_up_volt = <1800>;
/*tempetature table for byd*/
	batt_temperature_table_byd_num = <17 >;
	batt_temperature_table_byd = <
			    (-20) 78108
			    (-15) 59866
			    (-10) 50000
			    (-5) 37532
			    0 29000
			    5 24540
			    10 19925
			    15 15634
			    20 12690
			    25 10800
			    30 8609
			    35 7225 
			    40 5950 
			    45 4950 
			    50 4150 
			    55 3302 
			    60 2505 >;
				
	batt_temperature_table_num = <41>;
	batt_temperature_table = <
	            (-20)  68770      
			    (-18)  62232      
			    (-16)  57057      
			    (-14)  52568 
	            (-12)  47794      
			    (-10)  43445      
			    (-8)   41180      
			    (-6)   36622
	            (-4)   33420      
			    (-2)   31610      				
			    0      28282      
			    2      25862      
			    4     23640      
			    6     21153      
			    8     18867      
			    10     17646      
			    12     17071       
			    14     15045       
			    16     14727       
			    18     13480       
			    20     12350  
			    22     11360      
			    24     10597      
			    26     9920      
			    28     9251      
			    30     8504      
			    32     7923       
			    34     7275       
			    36     6859       
			    38     6347       
			    40     5932  
			    42     5493      
			    44     5220      
			    46     4817      
			    48     4547      
			    50     4177      
			    52     3964       
			    54     3706       
			    56     3473       
			    58     3215            
			    60     3028    >;
/*id2 for BYD battery*/
	battery_profile_id2_t0_num = <53 >;
	battery_profile_id2_t0 = <
				0   4335
				2   4295
				4   4268
				6   4243
				8   4220
				10  4198
				12  4176
				14  4156
				15  4136
				17  4115
				19  4095
				21  4079
				23  4066
				25  4041
				27  4005
				29  3978
				31  3958
				33  3945
				35  3933
				37  3919
				39  3904
				41  3889
				42  3875
				44  3861
				46  3850
				48  3838
				50  3827
				52  3819
				54  3810
				56  3802
				58  3795
				60  3789
				62  3783
				64  3778
				66  3775
				68  3770
				70  3768
				71  3765
				73  3762
				75  3758
				77  3754
				79  3749
				81  3743
				83  3735
				85  3726
				87  3715
				89  3703
				91  3694
				93  3686
				95  3679
				97  3665
				98  3616
				100 3502
				 >;

	battery_profile_id2_t1_num = <53 >;
	battery_profile_id2_t1 = <
				0   4335
				2   4295
				4   4268
				6   4243
				8   4220
				10  4198
				12  4176
				14  4156
				15  4136
				17  4115
				19  4095
				21  4079
				23  4066
				25  4041
				27  4005
				29  3978
				31  3958
				33  3945
				35  3933
				37  3919
				39  3904
				41  3889
				42  3875
				44  3861
				46  3850
				48  3838
				50  3827
				52  3819
				54  3810
				56  3802
				58  3795
				60  3789
				62  3783
				64  3778
				66  3775
				68  3770
				70  3768
				71  3765
				73  3762
				75  3758
				77  3754
				79  3749
				81  3743
				83  3735
				85  3726
				87  3715
				89  3703
				91  3694
				93  3686
				95  3679
				97  3665
				98  3616
				100 3502
				>;

	battery_profile_id2_t2_num = <53 >;
	battery_profile_id2_t2 = <
				0   4336
				2   4303
				4   4278
				6   4255
				8   4232
				10  4210
				12  4188
				13  4167
				15  4146
				17  4125
				19  4105
				21  4086
				23  4067
				25  4053
				27  4032
				29  4003
				31  3985
				33  3974
				35  3962
				37  3947
				38  3933
				40  3917
				42  3900
				44  3880
				46  3863
				48  3848
				50  3836
				52  3825
				54  3817
				56  3809
				58  3802
				60  3795
				61  3790
				63  3784
				65  3780
				67  3775
				69  3770
				71  3765
				73  3761
				75  3757
				77  3751
				79  3744
				81  3738
				83  3731
				85  3723
				86  3710
				88  3699
				90  3684
				92  3681
				94  3679
				96  3673
				98  3618
				100 3497
				 >;

	battery_profile_id2_t3_num = <53 >;
	battery_profile_id2_t3 = <
				0   4336
				2   4303
				4   4278
				6   4255
				8   4232
				10  4210
				12  4188
				13  4167
				15  4146
				17  4125
				19  4105
				21  4086
				23  4067
				25  4053
				27  4032
				29  4003
				31  3985
				33  3974
				35  3962
				37  3947
				38  3933
				40  3917
				42  3900
				44  3880
				46  3863
				48  3848
				50  3836
				52  3825
				54  3817
				56  3809
				58  3802
				60  3795
				61  3790
				63  3784
				65  3780
				67  3775
				69  3770
				71  3765
				73  3761
				75  3757
				77  3751
				79  3744
				81  3738
				83  3731
				85  3723
				86  3710
				88  3699
				90  3684
				92  3681
				94  3679
				96  3673
				98  3618
				100 3497
				>;

	r_profile_id2_t0_num = <53 >;
	r_profile_id2_t0 = <
				573       4335
				573       4295
				570       4268
				565       4243
				565       4220
				563       4198
				558       4176
				560       4156
				560       4136
				558       4115
				557       4095
				557       4079
				578       4066
				578       4041
				553       4005
				540       3978
				533       3958
				533       3945
				533       3933
				530       3919
				525       3904
				520       3889
				518       3875
				515       3861
				518       3850
				518       3838
				515       3827
				523       3819
				525       3810
				533       3802
				535       3795
				540       3789
				548       3783
				553       3778
				560       3775
				563       3770
				575       3768
				588       3765
				603       3762
				615       3758
				635       3754
				658       3749
				670       3743
				675       3735
				680       3726
				685       3715
				690       3703
				695       3694
				700       3686
				705       3679
				710       3665
				715       3616
				720       3502
				>;

	r_profile_id2_t1_num = <53 >;
	r_profile_id2_t1 = <
				573       4335
				573       4295
				570       4268
				565       4243
				565       4220
				563       4198
				558       4176
				560       4156
				560       4136
				558       4115
				557       4095
				557       4079
				578       4066
				578       4041
				553       4005
				540       3978
				533       3958
				533       3945
				533       3933
				530       3919
				525       3904
				520       3889
				518       3875
				515       3861
				518       3850
				518       3838
				515       3827
				523       3819
				525       3810
				533       3802
				535       3795
				540       3789
				548       3783
				553       3778
				560       3775
				563       3770
				575       3768
				588       3765
				603       3762
				615       3758
				635       3754
				658       3749
				670       3743
				675       3735
				680       3726
				685       3715
				690       3703
				695       3694
				700       3686
				705       3679
				710       3665
				715       3616
				720       3502
				>;

	r_profile_id2_t2_num = <53 >;
	r_profile_id2_t2 = <
				155       4336
				155       4303
				153       4278
				155       4255
				153       4232
				153       4210
				155       4188
				155       4167
				158       4146
				157       4125
				163       4105
				165       4086
				168       4067
				173       4053
				175       4032
				173       4003
				178       3985
				185       3974
				190       3962
				190       3947
				193       3933
				193       3917
				188       3900
				170       3880
				160       3863
				150       3848
				198       3836
				195       3825
				198       3817
				195       3809
				198       3802
				199       3795
				203       3790
				203       3784
				208       3780
				210       3775
				208       3770
				205       3765
				208       3761
				205       3757
				203       3751
				200       3744
				200       3738
				200       3731
				203       3723
				203       3710
				205       3699
				200       3684
				205       3681
				220       3679
				240       3673
				250       3618
				300       3497
				>;

	r_profile_id2_t3_num = <53 >;
	r_profile_id2_t3 = <
				155       4336
				155       4303
				153       4278
				155       4255
				153       4232
				153       4210
				155       4188
				155       4167
				158       4146
				157       4125
				163       4105
				165       4086
				168       4067
				173       4053
				175       4032
				173       4003
				178       3985
				185       3974
				190       3962
				190       3947
				193       3933
				193       3917
				188       3900
				170       3880
				160       3863
				150       3848
				198       3836
				195       3825
				198       3817
				195       3809
				198       3802
				199       3795
				203       3790
				203       3784
				208       3780
				210       3775
				208       3770
				205       3765
				208       3761
				205       3757
				203       3751
				200       3744
				200       3738
				200       3731
				203       3723
				203       3710
				205       3699
				200       3684
				205       3681
				220       3679
				240       3673
				250       3618
				300       3497
				>;
	battery_profile_t0_num = <55>;
	battery_profile_t0 = <
				0 	  4332 
				2 	  4286 
				4 	  4255 
				6 	  4229 
				8 	  4208 
				9 	  4186 
				11    4166 
				13    4146 
				15    4126  
				17    4107 
				19    4091 
				21    4074 
				23    4051 
				25    4021 
				26    3990 
				28    3965 
				30    3946 
				32    3930 
				34    3917 
				36    3905 
				38    3893 
				40    3881 
				41    3870 
				43    3859 
				45    3848 
				47    3838 
				49    3829 
				51    3820 
				53    3811 
				55    3804 
				57    3798 
				58    3793 
				60    3788 
				62    3785 
				64    3780 
				66    3777 
				68    3773 
				70    3769 
				72    3766 
				74    3761 
				75    3757 
				77    3751 
				79    3746 
				81    3739 
				83    3730 
				85    3721 
				87    3713 
				89    3705 
				90    3699 
				92    3691 
				94    3678 
				96    3649 
				98    3582 
				100   3448 
				102   3348 
				 >;

	battery_profile_t1_num = <55>;
	battery_profile_t1 = <
				0  4347
				2  4316
				4  4290
				6  4266
				7  4246
				9  4226
				11 4204
				13 4185
				15 4165
				17 4145
				19 4126
				21 4107
				22 4091
				24 4078
				26 4060
				28 4027
				30 3996
				32 3975
				34 3959
				36 3946
				37 3933
				39 3919
				41 3903
				43 3888
				45 3874
				47 3862
				49 3850
				51 3841
				52 3831
				54 3823
				56 3816
				58 3810
				60 3803
				62 3798
				64 3792
				66 3788
				67 3785
				69 3782
				71 3780
				73 3776
				75 3772
				77 3768
				79 3762
				81 3755
				82 3746
				84 3735
				86 3723
				88 3710
				90 3701
				92 3697
				94 3693
				96 3678
				97 3606
				99 3469
                100 3450				
				>;

	battery_profile_t2_num = <55>;
	battery_profile_t2 = <
				0     4337
				2     4302
				4 	  4275
				6 	  4252
				7 	  4229
				9 	  4208
				11    4188
				13    4167
				15    4147
				17    4128
				19    4107
				21    4088
				22    4071
				24    4059
				26    4044
				28    4010
				30    3984
				32    3968
				34    3957
				36    3952
				37    3940
				39    3927
				41    3909
				43    3889
				45    3870
				47    3854
				49    3842
				51    3831
				52    3822
				54    3813
				56    3806
				58    3798
				60    3793
				62    3787
				64    3782
				66    3777
				67    3773
				69    3769
				71    3764
				73    3759
				75    3754
				77    3749
				79    3741
				81    3735
				82    3728
				84    3718
				86    3707
				88    3695
				90    3682
				92    3681
				94    3672
				96    3665
				97    3616
				99    3499
				100   3460
				 >;

	battery_profile_t3_num = <55>;
	battery_profile_t3 = <
			    0 	  4335 
				2 	  4308 
				4 	  4284 
				6 	  4262 
				8 	  4240 
				9 	  4219 
				11    4198 
				13    4178 
				15    4158  
				17    4138 
				19    4118 
				21    4099 
				23    4080 
				25    4062 
				26    4045 
				28    4027 
				30    4010 
				32    3995 
				34    3979 
				36    3965 
				38    3951 
				40    3937 
				41    3920 
				43    3898 
				45    3879 
				47    3864 
				49    3852 
				51    3842 
				53    3832 
				55    3824 
				57    3816 
				58    3810 
				60    3803 
				62    3797 
				64    3790 
				66    3785 
				68    3780 
				70    3775 
				72    3765 
				74    3751 
				75    3743 
				77    3736 
				79    3727 
				81    3721 
				83    3713 
				85    3702 
				87    3692 
				89    3678 
				90    3672 
				92    3671 
				94    3669 
				96    3643 
				98    3560 
				100   3416 
				102   3101
				>;

	r_profile_t0_num = <55>;
	r_profile_t0 = <
	1772 4332 
	1772 4286 
	1719 4255 
	1666 4229 
	1625 4208 
	1581 4186 
	1549 4166 
	1513 4146 
	1485 4126 
	1459 4107 
	1446 4091 
	1432 4074 
	1405 4051 
	1366 4021 
	1329 3990 
	1305 3965 
	1296 3946 
	1291 3930 
	1288 3917 
	1285 3905 
	1278 3893 
	1271 3881 
	1266 3870 
	1260 3859 
	1259 3848 
	1257 3838 
	1256 3829 
	1256 3820 
	1256 3811 
	1259 3804 
	1267 3798 
	1278 3793 
	1290 3788 
	1305 3785 
	1319 3780 
	1335 3777 
	1350 3773 
	1366 3769 
	1381 3766 
	1400 3761 
	1417 3757 
	1436 3751 
	1457 3746 
	1480 3739 
	1505 3730 
	1533 3721 
	1566 3713 
	1608 3705 
	1662 3699 
	1727 3691 
	1806 3678 
	1899 3649 
	1998 3582 
	2176 3448 
	2176 3348  
				>;
	r_profile_t1_num = <55>;
	r_profile_t1 = <
	114    4347 
	154    4316 
	157    4290 
	157    4266 
	226    4246 
	234    4226 
	244    4204 
	266    4185 
	284    4165 
	325    4145 
	341    4126 
	366    4107 
	388    4091 
	395    4078 
	391    4060 
	358    4027 
	333    3996 
	526    3975 
	519    3959 
	516    3946 
	509    3933 
	594    3919 
	579    3903 
	567    3888 
	561    3874 
	556    3862 
	550    3850 
	539    3841 
	489    3831 
	460    3823 
	444    3816 
	431    3810 
	442    3803 
	448    3798 
	441    3792 
	459    3788 
	441    3785 
	452    3782 
	458    3780 
	430    3776 
	421    3772 
	415    3768 
	416    3762 
	414    3755 
	410    3746 
	398    3735 
	388    3723 
	368    3710 
	358    3701 
	348    3697 
	328    3693 
	310    3678 
	300    3606 
	300    3469 
    300    3450 
				>;
	r_profile_t2_num = <55>;
	r_profile_t2 = <
				     90  4337
				     90  4302
				     90  4275
				     90  4252
				     90  4229
				     90  4208
				     90  4188
				     90  4167
				     90  4147
				     90  4128
				     90  4107
				     90  4088
				     90  4071
				     90  4059
				     90  4044
				     90  4010
				     90  3984
				     90  3968
				     90  3957
				     90  3952
				     90  3940
				     90  3927
				     90  3909
				     90  3889
				     90  3870
				     90  3854
				     90  3842
				     90  3831
				     90  3822
				     90  3813
				     90  3806
				     90  3798
				     90  3793
				     90  3787
				     90  3782
				     90  3777
				     90  3773
				     90  3769
				     90  3764
				     90  3759
				     90  3754
				     90  3749
				     90  3741
				     90  3735
				     90  3728
				     90  3718
				     90  3707
				     90  3695
				     90  3682
				     90  3681
				     90  3679
				     90  3672
				     90  3616
				     90  3499
				     90  3241  
				>;

	r_profile_t3_num = <55>;
	r_profile_t3 = <
	192  4335 
	192  4308 
	194  4284 
	191  4262 
	192  4240 
	194  4219 
	192  4198 
	194  4178 
	195  4158 
	194  4138 
	195  4118 
	197  4099 
	198  4080 
	197  4062 
	200  4045 
	200  4027 
	201  4010 
	205  3995 
	206  3979 
	208  3965 
	212  3951 
	218  3937 
	222  3920 
	209  3898 
	200  3879 
	197  3864 
	196  3852 
	194  3842 
	194  3832 
	196  3824 
	195  3816 
	198  3810 
	200  3803 
	202  3797 
	202  3790 
	205  3785 
	206  3780 
	208  3775 
	203  3765 
	199  3751 
	200  3743 
	200  3736 
	198  3727 
	200  3721 
	200  3713 
	199  3702 
	202  3692 
	198  3678 
	195  3672 
	203  3671 
	216  3669 
	209  3643 
	219  3560 
	250  3416 
	854  3101 
				>;

};
