## drivers/input/sensortek/Kconfig
```kconfig
config PLGS_STK3420
	tristate "Sensors PLGS_STK3420"
	select PLGS_STK3420
	default n
	help
	  This driver provides support for the PLGS_STK3420.
```

## drivers/misc/mediatek/sensors-1.0/alsps/em20918/Kconfig
```kconfig
config PLGS_EM20918
	tristate "Sensors PLGS_EM20918"
	select PLGS_EM20918
	default n
	help
	  This driver provides support for the PLGS_EM20918.
```

## drivers/misc/mediatek/simple_vibrator/Kconfig
```kconfig
config SIMPLE_MOTOR
       tristate "simple motor driver"
       default n
       help
         simple motor driver.
```
